## app/fireeye/Kconfig
```kconfig
config FIREYEYE
	bool "FireEye Electric Bicycle Charging Safety Monitor"
	default n
	---help---
		Enable FireEye - Electric Bicycle Charging Safety Monitor application.
		This application monitors charging current, temperature, and leakage
		for electric bicycle charging safety.

if FIREYEYE

config FIREYEYE_PRIORITY
	int "FireEye main task priority"
	default 200
	---help---
		Priority of the FireEye main monitoring task.

config FIREYEYE_STACKSIZE
	int "FireEye main task stack size"
	default 4096
	---help---
		Stack size of the FireEye main monitoring task.

config FIREYEYE_SAMPLE_RATE
	int "Sensor sample rate (Hz)"
	default 10
	---help---
		Sensor sampling rate in Hz.

config FIREYEYE_CURRENT_WARNING
	int "Current warning threshold (x0.1 A)"
	default 50
	---help---
		Current warning threshold in tenths of an Amp (50 = 5.0A).

config FIREYEYE_CURRENT_ALARM
	int "Current alarm threshold (x0.1 A)"
	default 80
	---help---
		Current alarm threshold in tenths of an Amp (80 = 8.0A).

config FIREYEYE_TEMP_WARNING
	int "Temperature warning threshold (x0.1 C)"
	default 450
	---help---
		Temperature warning threshold in tenths of Celsius (450 = 45.0C).

config FIREYEYE_TEMP_ALARM
	int "Temperature alarm threshold (x0.1 C)"
	default 600
	---help---
		Temperature alarm threshold in tenths of Celsius (600 = 60.0C).

config FIREYEYE_DEBOUNCE_COUNT
	int "Debounce count"
	default 3
	---help---
		Number of consecutive over-limit readings before triggering alarm.

endif # FIREYEYE

config FIREYEYE_NET
	bool "Enable Ethernet reporting (W5500)"
	default n
	depends on NET_W5500
	---help---
		Enable FireEye data reporting to a PC over Ethernet (W5500).

config FIREYEYE_STORAGE
	bool "Enable local event history in on-chip FLASH"
	default y
	depends on ARCH_HAVE_PROGMEM
	---help---
		Keep state-change and heartbeat records in the on-chip FLASH
		progmem region so that the alarm history survives power cycles.
		No external memory device is required.
```
